## firmware/sdkconfig.defaults
```kconfig
CONFIG_IDF_TARGET="esp32p4"

# Flash
CONFIG_ESPTOOLPY_FLASHMODE_QIO=y
CONFIG_ESPTOOLPY_FLASHSIZE_16MB=y

# Custom partition table
CONFIG_PARTITION_TABLE_CUSTOM=y

# CPU performance
CONFIG_COMPILER_OPTIMIZATION_PERF=y

# PSRAM — ESP32-P4 uses HEX mode automatically; 200M requires experimental flag
CONFIG_IDF_EXPERIMENTAL_FEATURES=y
CONFIG_SPIRAM=y
CONFIG_SPIRAM_SPEED_200M=y
CONFIG_SPIRAM_XIP_FROM_PSRAM=n
CONFIG_CACHE_L2_CACHE_256KB=y
CONFIG_CACHE_L2_CACHE_LINE_128B=y

# FreeRTOS
CONFIG_FREERTOS_HZ=1000
CONFIG_ESP_MAIN_TASK_STACK_SIZE=10240

# LVGL v9 — FreeRTOS integration, 2 draw units for dual-core P4
CONFIG_LV_USE_CLIB_MALLOC=y
CONFIG_LV_USE_CLIB_STRING=y
CONFIG_LV_USE_CLIB_SPRINTF=y
CONFIG_LV_DEF_REFR_PERIOD=15
CONFIG_LV_OS_FREERTOS=y
CONFIG_LV_DRAW_SW_DRAW_UNIT_CNT=2
CONFIG_LV_ATTRIBUTE_FAST_MEM_USE_IRAM=n

# Fonts used by the UI
CONFIG_LV_FONT_MONTSERRAT_16=y
CONFIG_LV_FONT_MONTSERRAT_20=y
CONFIG_LV_FONT_MONTSERRAT_24=y
CONFIG_LV_FONT_MONTSERRAT_48=y

# LVGL 9.5 — Espressif PPA hardware accelerator (ESP32-P4)
CONFIG_LV_USE_PPA=y
CONFIG_LV_USE_PPA_IMG=y
CONFIG_LV_PPA_BURST_LENGTH=128
# Draw buffer alignment must match L2 cache line size (128 B on P4)
CONFIG_LV_DRAW_BUF_ALIGN=128

# LVGL 9.5 — shadow calc cache (avoids recomputing same radius each frame)
CONFIG_LV_DRAW_SW_SHADOW_CACHE_SIZE=8

# I2C — force codec to use new driver_ng API (avoids old/new driver conflict)
CONFIG_CODEC_I2C_BACKWARD_COMPATIBLE=n

# ESP-Hosted — C6 WiFi co-processor over SDIO
CONFIG_ESP_HOSTED_ENABLED=y
CONFIG_ESP_HOSTED_SDIO_HOST_INTERFACE=y
CONFIG_ESP_HOSTED_IDF_SLAVE_TARGET="esp32c6"
CONFIG_ESP_HOSTED_SDIO_CLK_GPIO=18
CONFIG_ESP_HOSTED_SDIO_CMD_GPIO=19
CONFIG_ESP_HOSTED_SDIO_D0_GPIO=14
CONFIG_ESP_HOSTED_SDIO_D1_GPIO=15
CONFIG_ESP_HOSTED_SDIO_D2_GPIO=16
CONFIG_ESP_HOSTED_SDIO_D3_GPIO=17
CONFIG_ESP_HOSTED_SLAVE_RESET_GPIO=54

# WiFi — route esp_wifi_* API through esp-hosted to C6 co-processor
CONFIG_ESP_WIFI_REMOTE_LIBRARY_HOSTED=y

# Networking — enough sockets for httpd(13) + WebSocket + DNS + system
CONFIG_LWIP_MAX_SOCKETS=20

# TLS: skip server cert verification (needed for self-signed HA cert)
CONFIG_ESP_TLS_SKIP_SERVER_CERT_VERIFY=y

# Logging — keep INFO; DEBUG floods UART and blocks httpd
CONFIG_LOG_DEFAULT_LEVEL_INFO=y

# OTA / HTTP server
CONFIG_HTTPD_MAX_REQ_HDR_LEN=1024
CONFIG_HTTPD_RECV_WAITTIME=30
CONFIG_ESP_HTTPS_OTA_ALLOW_HTTP=y
```
